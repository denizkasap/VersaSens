## prj.conf
```kconfig
CONFIG_DK_LIBRARY=y

CONFIG_GPIO=y
CONFIG_CLOCK_CONTROL=y
CONFIG_CLOCK_CONTROL_NRF_K32SRC_RC=y
CONFIG_CLOCK_CONTROL_NRF_K32SRC_XTAL=n
CONFIG_SOC_ENABLE_LFXO=n

CONFIG_BT=y
CONFIG_BT_DEBUG_LOG=y
CONFIG_BT_PERIPHERAL=y
CONFIG_BT_DEVICE_NAME="VersaSens"
CONFIG_BT_BAS=y
# CONFIG_BT_HRS=y

CONFIG_BT_CTLR_ADV_EXT=y

CONFIG_BT_EXT_ADV=y
CONFIG_BT_USER_PHY_UPDATE=y

CONFIG_BT_USER_DATA_LEN_UPDATE=y
CONFIG_BT_USER_PHY_UPDATE=y

CONFIG_BT_BUF_ACL_RX_SIZE=251
CONFIG_BT_ATT_PREPARE_COUNT=2
CONFIG_BT_L2CAP_TX_BUF_COUNT=10
CONFIG_BT_L2CAP_TX_MTU=247
CONFIG_BT_CONN_TX_MAX=10
CONFIG_BT_BUF_ACL_TX_COUNT=20
CONFIG_BT_BUF_ACL_TX_SIZE=251
CONFIG_SYSTEM_WORKQUEUE_STACK_SIZE=2048
CONFIG_BT_BUF_ACL_RX_COUNT=20
CONFIG_BT_BUF_ACL_RX_SIZE=251

CONFIG_BT_USER_DATA_LEN_UPDATE=y
CONFIG_BT_GATT_CLIENT=y

CONFIG_BT_GAP_AUTO_UPDATE_CONN_PARAMS=y
CONFIG_BT_PERIPHERAL_PREF_MIN_INT=6
CONFIG_BT_PERIPHERAL_PREF_MAX_INT=6

CONFIG_PINCTRL=y
CONFIG_NRFX_TWIM2=y
CONFIG_NRFX_TWIM3=y
# CONFIG_I2C=y
# CONFIG_I2C_NRFX=y
CONFIG_NRFX_UARTE1=y
CONFIG_NRFX_PDM=y
CONFIG_NRFX_SPIM3=y
CONFIG_NRFX_SPIM4=y
CONFIG_NRFX_SPIS0=y

CONFIG_NRFX_GPIOTE=y

CONFIG_LOG=y
CONFIG_ASSERT=y

CONFIG_DISK_ACCESS=y
CONFIG_FILE_SYSTEM=y
CONFIG_FAT_FILESYSTEM_ELM=y
CONFIG_PRINTK=y
CONFIG_SPI=y
CONFIG_DISK_DRIVER_SDMMC=y
CONFIG_NORDIC_QSPI_NOR=y

CONFIG_MAIN_STACK_SIZE=50000

CONFIG_NORDIC_QSPI_NOR=y
CONFIG_NORDIC_QSPI_NOR_FLASH_LAYOUT_PAGE_SIZE=4096
CONFIG_DISK_DRIVERS=y
CONFIG_DISK_DRIVER_FLASH=y

CONFIG_SDHC=y
CONFIG_DISK_DRIVER_SDMMC=y

CONFIG_STDOUT_CONSOLE=y

#USB related configs
CONFIG_USB_DEVICE_STACK=y
CONFIG_USB_DEVICE_PRODUCT="Zephyr MSC sample"
CONFIG_USB_DEVICE_PID=0x0008
CONFIG_USB_DRIVER_LOG_LEVEL_ERR=y
CONFIG_USB_MASS_STORAGE=y
CONFIG_USB_DEVICE_LOG_LEVEL_ERR=y
CONFIG_USB_MASS_STORAGE_LOG_LEVEL_ERR=y
CONFIG_USB_DEVICE_INITIALIZE_AT_BOOT=n
CONFIG_MASS_STORAGE_DISK_NAME="SD"
CONFIG_MASS_STORAGE_STACK_SIZE=8192

CONFIG_POSIX_API=y

CONFIG_USB_CDC_ACM=y
CONFIG_USB_COMPOSITE_DEVICE=y

# CONFIG_LOG=y
CONFIG_CONSOLE=y
CONFIG_RTT_CONSOLE=y
CONFIG_USE_SEGGER_RTT=y
CONFIG_UART_CONSOLE=n
CONFIG_SEGGER_RTT_BUFFER_SIZE_UP=1024
CONFIG_RTT_TX_RETRY_CNT=10
CONFIG_RTT_TX_RETRY_DELAY_MS=1

CONFIG_LOG_BUFFER_SIZE=4096

# allocate heap memory for fifo
CONFIG_HEAP_MEM_POOL_SIZE=16384

#CONFIG_THREAD_ANALYZER=y
#CONFIG_THREAD_ANALYZER_USE_PRINTK=y
#CONFIG_THREAD_ANALYZER_AUTO=y
#CONFIG_THREAD_ANALYZER_AUTO_INTERVAL=5
#CONFIG_THREAD_NAME=y
```

## src/main.c
```c
#include <zephyr/kernel.h>
#include <zephyr/types.h>
#include <zephyr/usb/usb_device.h>
#include <time.h>
#include <zephyr/bluetooth/bluetooth.h>
#include <zephyr/bluetooth/conn.h>
#include <zephyr/bluetooth/uuid.h>
#include <zephyr/bluetooth/gatt.h>
#include <zephyr/bluetooth/hci.h>
#include <nrfx_gpiote.h>
#include "FDC2214.h"
#include "MAX77658.h"
#include "versa_ble.h"
#include "twim_inst.h"
#include "storage.h"
#include "ADS1298.h"
#include "MAX30001.h"
#include "versa_api.h"
#include <zephyr/devicetree.h>
#include <zephyr/storage/disk_access.h>
#include <zephyr/logging/log.h>
#include <zephyr/fs/fs.h>
#include <ff.h>
#include <SPI_Heepocrates.h>
#include "app_data.h"

LOG_MODULE_REGISTER(main, LOG_LEVEL_INF);


int main(void)
{
    printk("Started!\n");
    nrf_gpio_cfg_output(START_PIN);
    nrf_gpio_pin_set(START_PIN);
    
    versa_init();
    // enable_auto_connect();
    versa_config();

    versa_start_led_thread();
    versa_start_mode_thread();

    //SPI_Heepocrates_init();

    while (1)
    {
        // data aquisition example
        k_sleep(K_MSEC(500));
    }
}
```
